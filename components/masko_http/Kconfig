## components/masko_http/Kconfig
```kconfig
menu "Masko HTTP transport"

config MASKO_HTTP_RX_BUFFER_KIB
    int "HTTP receive buffer (KiB)"
    range 4 16
    default 4
    help
        Allocated per HTTP client. Larger buffers can improve transfer rate,
        but reduce the internal heap available to TLS and display DMA.

config MASKO_HTTP_TIMEOUT_MS
    int "HTTP request timeout (ms)"
    range 1000 30000
    default 8000

endmenu
```

## examples/waveshare_amoled_175/main/Kconfig.projbuild
```kconfig
menu "Masko demo"

config MASKO_STREAM_ENABLE
    bool "Stream the full Kylo mascot over Wi-Fi"
    default n
    help
        Use the public Kylo CDN packs and the bundled delivery graph.
        The local offline demo remains available when this is disabled.

config MASKO_STREAM_SSID
    string "Wi-Fi SSID for streaming demo"
    depends on MASKO_STREAM_ENABLE
    default ""

config MASKO_STREAM_PASSWORD
    string "Wi-Fi password for streaming demo (keep sdkconfig local)"
    depends on MASKO_STREAM_ENABLE
    default ""

config MASKO_STREAM_PROBE_ONLY
    bool "Only measure Wi-Fi and CDN range speed at startup"
    depends on MASKO_STREAM_ENABLE
    default n

config MASKO_STREAM_CACHE_KIB
    int "Compressed cache per slot (KiB; two slots per open clip)"
    depends on MASKO_STREAM_ENABLE
    default 512
    range 128 1024

config MASKO_STREAM_FULL_CACHE_KIB
    int "Maximum per-clip PSRAM cache (KiB; 0 disables full-clip caching)"
    depends on MASKO_STREAM_ENABLE
    default 2304
    range 0 4096

config MASKO_PACK_IN_FLASH
    bool "Play the pack from the 'masko' flash partition"
    default y
    help
        The .mkpk is flashed into the 'masko' data partition and mmapped.
        Deselect to fall back to a pack compiled into the app image, which is
        convenient for quick iteration but bloats the binary.

config MASKO_PACK_MAX_FPS
    int "Frame rate cap"
    default 24
    range 1 60

config MASKO_SINGLE_PACK_BENCHMARK
    bool "Run a single-pack benchmark instead of the Kylo state graph"
    default n
    help
        Read one .mkpk from the masko partition and play it continuously.
        The demo reports playback metrics every 30 seconds. Useful for
        controlled comparisons of quality and frame-rate exports.

endmenu
```
